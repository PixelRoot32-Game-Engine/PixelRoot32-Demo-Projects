// Generated by tools/sfx_design.py from tools/DOOM1.WAD -- do not edit.
// One row per sfxenum_t value, indexed by the id itself (row 0 is
// upstream's dummy). See tools/sfx_fit.txt for the fit and the donor of
// every id the shareware WAD has no lump for.
/*   0 none     */ {SfxWave::Pulse, 440.0f, 0.0f, 0.0010f, 0.000f, 0.500f, 0u, 0.0010f, 0.0000f, 1.000f, 0.0050f, false, SfxClass::Normal, {{0.0f, 0.0f}, {0.0f, 0.0f}, {0.0f, 0.0f}, {0.0f, 0.0f}}, 0u, {{0.0f, 0.5f}, {0.0f, 0.5f}, {0.0f, 0.5f}, {0.0f, 0.5f}}, 0u},
/*   1 pistol   */ {SfxWave::Noise, 3200.0f, 0.0f, 0.5135f, 0.728f, 0.500f, 0u, 0.0010f, 0.3851f, 0.011f, 0.0963f, false, SfxClass::Reserved, {{0.0f, 0.0f}, {0.0f, 0.0f}, {0.0f, 0.0f}, {0.0f, 0.0f}}, 0u, {{0.0f, 0.5f}, {0.0f, 0.5f}, {0.0f, 0.5f}, {0.0f, 0.5f}}, 0u},
/*   2 shotgn   */ {SfxWave::Noise, 3200.0f, 0.0f, 0.8567f, 0.774f, 0.500f, 0u, 0.0535f, 0.6425f, 0.147f, 0.0535f, false, SfxClass::Reserved, {{0.0f, 0.0f}, {0.0f, 0.0f}, {0.0f, 0.0f}, {0.0f, 0.0f}}, 0u, {{0.0f, 0.5f}, {0.0f, 0.5f}, {0.0f, 0.5f}, {0.0f, 0.5f}}, 0u},
/*   3 sgcock   */ {SfxWave::Noise, 12000.0f, 0.0f, 0.5350f, 0.348f, 0.500f, 0u, 0.1003f, 0.0334f, 0.299f, 0.0334f, true, SfxClass::Reserved, {{0.0f, 0.0f}, {0.0f, 0.0f}, {0.0f, 0.0f}, {0.0f, 0.0f}}, 0u, {{0.0f, 0.5f}, {0.0f, 0.5f}, {0.0f, 0.5f}, {0.0f, 0.5f}}, 0u},
/*   4 dshtgn   from shotgn */ {SfxWave::Noise, 3200.0f, 0.0f, 0.8567f, 0.774f, 0.500f, 0u, 0.0535f, 0.6425f, 0.147f, 0.0535f, false, SfxClass::Reserved, {{0.0f, 0.0f}, {0.0f, 0.0f}, {0.0f, 0.0f}, {0.0f, 0.0f}}, 0u, {{0.0f, 0.5f}, {0.0f, 0.5f}, {0.0f, 0.5f}, {0.0f, 0.5f}}, 0u},
/*   5 dbopn    from sgcock */ {SfxWave::Noise, 12000.0f, 0.0f, 0.5350f, 0.348f, 0.500f, 0u, 0.1003f, 0.0334f, 0.299f, 0.0334f, true, SfxClass::Reserved, {{0.0f, 0.0f}, {0.0f, 0.0f}, {0.0f, 0.0f}, {0.0f, 0.0f}}, 0u, {{0.0f, 0.5f}, {0.0f, 0.5f}, {0.0f, 0.5f}, {0.0f, 0.5f}}, 0u},
/*   6 dbcls    from sgcock */ {SfxWave::Noise, 12000.0f, 0.0f, 0.5350f, 0.348f, 0.500f, 0u, 0.1003f, 0.0334f, 0.299f, 0.0334f, true, SfxClass::Reserved, {{0.0f, 0.0f}, {0.0f, 0.0f}, {0.0f, 0.0f}, {0.0f, 0.0f}}, 0u, {{0.0f, 0.5f}, {0.0f, 0.5f}, {0.0f, 0.5f}, {0.0f, 0.5f}}, 0u},
/*   7 dbload   from sgcock */ {SfxWave::Noise, 12000.0f, 0.0f, 0.5350f, 0.348f, 0.500f, 0u, 0.1003f, 0.0334f, 0.299f, 0.0334f, true, SfxClass::Reserved, {{0.0f, 0.0f}, {0.0f, 0.0f}, {0.0f, 0.0f}, {0.0f, 0.0f}}, 0u, {{0.0f, 0.5f}, {0.0f, 0.5f}, {0.0f, 0.5f}, {0.0f, 0.5f}}, 0u},
/*   8 plasma   from rlaunc */ {SfxWave::Noise, 2800.0f, 0.0f, 1.4044f, 0.708f, 0.500f, 0u, 0.0010f, 0.7022f, 0.044f, 0.1000f, false, SfxClass::Reserved, {{0.0f, 0.0f}, {0.0f, 0.0f}, {0.0f, 0.0f}, {0.0f, 0.0f}}, 0u, {{0.0f, 0.5f}, {0.0f, 0.5f}, {0.0f, 0.5f}, {0.0f, 0.5f}}, 0u},
/*   9 bfg      from rxplod */ {SfxWave::Noise, 3700.0f, 0.0f, 1.3129f, 0.801f, 0.500f, 0u, 0.0010f, 1.2308f, 0.468f, 0.0050f, false, SfxClass::Reserved, {{0.0f, 0.0f}, {0.0f, 0.0f}, {0.0f, 0.0f}, {0.0f, 0.0f}}, 0u, {{0.0f, 0.5f}, {0.0f, 0.5f}, {0.0f, 0.5f}, {0.0f, 0.5f}}, 0u},
/*  10 sawup    */ {SfxWave::Noise, 12000.0f, 0.0f, 1.4775f, 0.616f, 0.500f, 0u, 0.2770f, 1.1081f, 0.939f, 0.0050f, true, SfxClass::Reserved, {{0.0f, 0.0f}, {0.0f, 0.0f}, {0.0f, 0.0f}, {0.0f, 0.0f}}, 0u, {{0.0f, 0.5f}, {0.0f, 0.5f}, {0.0f, 0.5f}, {0.0f, 0.5f}}, 0u},
/*  11 sawidl   */ {SfxWave::Noise, 4500.0f, 0.0f, 0.6831f, 0.417f, 0.500f, 0u, 0.1281f, 0.2135f, 0.468f, 0.0050f, false, SfxClass::Reserved, {{0.0f, 0.0f}, {0.0f, 0.0f}, {0.0f, 0.0f}, {0.0f, 0.0f}}, 0u, {{0.0f, 0.5f}, {0.0f, 0.5f}, {0.0f, 0.5f}, {0.0f, 0.5f}}, 0u},
/*  12 sawful   */ {SfxWave::Noise, 12000.0f, 0.0f, 1.6414f, 0.777f, 0.500f, 0u, 0.0010f, 0.3078f, 0.930f, 0.0050f, true, SfxClass::Reserved, {{0.0f, 0.0f}, {0.0f, 0.0f}, {0.0f, 0.0f}, {0.0f, 0.0f}}, 0u, {{0.0f, 0.5f}, {0.0f, 0.5f}, {0.0f, 0.5f}, {0.0f, 0.5f}}, 0u},
/*  13 sawhit   */ {SfxWave::Noise, 4500.0f, 0.0f, 0.7265f, 0.907f, 0.500f, 0u, 0.0908f, 0.0454f, 0.852f, 0.0050f, false, SfxClass::Reserved, {{0.0f, 0.0f}, {0.0f, 0.0f}, {0.0f, 0.0f}, {0.0f, 0.0f}}, 0u, {{0.0f, 0.5f}, {0.0f, 0.5f}, {0.0f, 0.5f}, {0.0f, 0.5f}}, 0u},
/*  14 rlaunc   */ {SfxWave::Noise, 2800.0f, 0.0f, 1.4044f, 0.708f, 0.500f, 0u, 0.0010f, 0.7022f, 0.044f, 0.1000f, false, SfxClass::Reserved, {{0.0f, 0.0f}, {0.0f, 0.0f}, {0.0f, 0.0f}, {0.0f, 0.0f}}, 0u, {{0.0f, 0.5f}, {0.0f, 0.5f}, {0.0f, 0.5f}, {0.0f, 0.5f}}, 0u},
/*  15 rxplod   */ {SfxWave::Noise, 3700.0f, 0.0f, 1.3129f, 0.801f, 0.500f, 0u, 0.0010f, 1.2308f, 0.468f, 0.0050f, false, SfxClass::High, {{0.0f, 0.0f}, {0.0f, 0.0f}, {0.0f, 0.0f}, {0.0f, 0.0f}}, 0u, {{0.0f, 0.5f}, {0.0f, 0.5f}, {0.0f, 0.5f}, {0.0f, 0.5f}}, 0u},
/*  16 firsht   */ {SfxWave::Noise, 6000.0f, 0.0f, 1.3370f, 0.639f, 0.500f, 0u, 0.4178f, 0.8356f, 0.213f, 0.0050f, false, SfxClass::Normal, {{0.0f, 0.0f}, {0.0f, 0.0f}, {0.0f, 0.0f}, {0.0f, 0.0f}}, 0u, {{0.0f, 0.5f}, {0.0f, 0.5f}, {0.0f, 0.5f}, {0.0f, 0.5f}}, 0u},
/*  17 firxpl   */ {SfxWave::Noise, 3200.0f, 0.0f, 1.0606f, 0.625f, 0.500f, 0u, 0.0663f, 0.4640f, 0.354f, 0.0050f, false, SfxClass::High, {{0.0f, 0.0f}, {0.0f, 0.0f}, {0.0f, 0.0f}, {0.0f, 0.0f}}, 0u, {{0.0f, 0.5f}, {0.0f, 0.5f}, {0.0f, 0.5f}, {0.0f, 0.5f}}, 0u},
/*  18 pstart   */ {SfxWave::Noise, 3700.0f, 0.0f, 0.7463f, 0.506f, 0.500f, 0u, 0.0010f, 0.1866f, 0.457f, 0.0050f, false, SfxClass::High, {{0.0f, 0.0f}, {0.0f, 0.0f}, {0.0f, 0.0f}, {0.0f, 0.0f}}, 0u, {{0.0f, 0.5f}, {0.0f, 0.5f}, {0.0f, 0.5f}, {0.0f, 0.5f}}, 0u},
/*  19 pstop    */ {SfxWave::Noise, 2100.0f, 0.0f, 0.6039f, 0.545f, 0.500f, 0u, 0.1510f, 0.3397f, 0.105f, 0.0377f, false, SfxClass::High, {{0.0f, 0.0f}, {0.0f, 0.0f}, {0.0f, 0.0f}, {0.0f, 0.0f}}, 0u, {{0.0f, 0.5f}, {0.0f, 0.5f}, {0.0f, 0.5f}, {0.0f, 0.5f}}, 0u},
/*  20 doropn   */ {SfxWave::Noise, 3700.0f, 0.0f, 1.2532f, 0.597f, 0.500f, 0u, 0.0783f, 0.2350f, 0.441f, 0.0050f, false, SfxClass::High, {{0.0f, 0.0f}, {0.0f, 0.0f}, {0.0f, 0.0f}, {0.0f, 0.0f}}, 0u, {{0.0f, 0.5f}, {0.0f, 0.5f}, {0.0f, 0.5f}, {0.0f, 0.5f}}, 0u},
/*  21 dorcls   */ {SfxWave::Noise, 4500.0f, 0.0f, 1.2591f, 0.661f, 0.500f, 0u, 0.1574f, 0.3935f, 0.586f, 0.0050f, false, SfxClass::High, {{0.0f, 0.0f}, {0.0f, 0.0f}, {0.0f, 0.0f}, {0.0f, 0.0f}}, 0u, {{0.0f, 0.5f}, {0.0f, 0.5f}, {0.0f, 0.5f}, {0.0f, 0.5f}}, 0u},
/*  22 stnmov   */ {SfxWave::Noise, 1900.0f, 0.0f, 0.2684f, 0.499f, 0.500f, 0u, 0.0336f, 0.0839f, 0.651f, 0.0050f, false, SfxClass::High, {{0.0f, 0.0f}, {0.0f, 0.0f}, {0.0f, 0.0f}, {0.0f, 0.0f}}, 0u, {{0.0f, 0.5f}, {0.0f, 0.5f}, {0.0f, 0.5f}, {0.0f, 0.5f}}, 0u},
/*  23 swtchn   */ {SfxWave::Noise, 3200.0f, 0.0f, 0.5673f, 0.691f, 0.500f, 0u, 0.0355f, 0.3546f, 0.131f, 0.0050f, false, SfxClass::High, {{0.0f, 0.0f}, {0.0f, 0.0f}, {0.0f, 0.0f}, {0.0f, 0.0f}}, 0u, {{0.0f, 0.5f}, {0.0f, 0.5f}, {0.0f, 0.5f}, {0.0f, 0.5f}}, 0u},
/*  24 swtchx   */ {SfxWave::Noise, 4500.0f, 0.0f, 0.4901f, 0.582f, 0.500f, 0u, 0.0010f, 0.1225f, 0.188f, 0.0306f, false, SfxClass::High, {{0.0f, 0.0f}, {0.0f, 0.0f}, {0.0f, 0.0f}, {0.0f, 0.0f}}, 0u, {{0.0f, 0.5f}, {0.0f, 0.5f}, {0.0f, 0.5f}, {0.0f, 0.5f}}, 0u},
/*  25 plpain   */ {SfxWave::Noise, 4500.0f, 0.0f, 1.3743f, 0.518f, 0.500f, 0u, 0.0859f, 0.2577f, 0.188f, 0.0050f, false, SfxClass::Reserved, {{0.0f, 0.0f}, {0.0f, 0.0f}, {0.0f, 0.0f}, {0.0f, 0.0f}}, 0u, {{0.0f, 0.5f}, {0.0f, 0.5f}, {0.0f, 0.5f}, {0.0f, 0.5f}}, 0u},
/*  26 dmpain   */ {SfxWave::Noise, 2800.0f, 0.0f, 0.8627f, 0.907f, 0.500f, 0u, 0.0010f, 0.8088f, 0.406f, 0.0050f, false, SfxClass::Normal, {{0.0f, 0.0f}, {0.0f, 0.0f}, {0.0f, 0.0f}, {0.0f, 0.0f}}, 0u, {{0.0f, 0.5f}, {0.0f, 0.5f}, {0.0f, 0.5f}, {0.0f, 0.5f}}, 0u},
/*  27 popain   */ {SfxWave::Noise, 2800.0f, 0.0f, 0.7832f, 0.893f, 0.500f, 0u, 0.0010f, 0.2937f, 0.635f, 0.0050f, false, SfxClass::Normal, {{0.0f, 0.0f}, {0.0f, 0.0f}, {0.0f, 0.0f}, {0.0f, 0.0f}}, 0u, {{0.0f, 0.5f}, {0.0f, 0.5f}, {0.0f, 0.5f}, {0.0f, 0.5f}}, 0u},
/*  28 vipain   from popain */ {SfxWave::Noise, 2800.0f, 0.0f, 0.7832f, 0.893f, 0.500f, 0u, 0.0010f, 0.2937f, 0.635f, 0.0050f, false, SfxClass::Normal, {{0.0f, 0.0f}, {0.0f, 0.0f}, {0.0f, 0.0f}, {0.0f, 0.0f}}, 0u, {{0.0f, 0.5f}, {0.0f, 0.5f}, {0.0f, 0.5f}, {0.0f, 0.5f}}, 0u},
/*  29 mnpain   from dmpain */ {SfxWave::Noise, 2800.0f, 0.0f, 0.8627f, 0.907f, 0.500f, 0u, 0.0010f, 0.8088f, 0.406f, 0.0050f, false, SfxClass::Normal, {{0.0f, 0.0f}, {0.0f, 0.0f}, {0.0f, 0.0f}, {0.0f, 0.0f}}, 0u, {{0.0f, 0.5f}, {0.0f, 0.5f}, {0.0f, 0.5f}, {0.0f, 0.5f}}, 0u},
/*  30 pepain   from dmpain */ {SfxWave::Noise, 2800.0f, 0.0f, 0.8627f, 0.907f, 0.500f, 0u, 0.0010f, 0.8088f, 0.406f, 0.0050f, false, SfxClass::Normal, {{0.0f, 0.0f}, {0.0f, 0.0f}, {0.0f, 0.0f}, {0.0f, 0.0f}}, 0u, {{0.0f, 0.5f}, {0.0f, 0.5f}, {0.0f, 0.5f}, {0.0f, 0.5f}}, 0u},
/*  31 slop     */ {SfxWave::Noise, 4500.0f, 0.0f, 1.0084f, 0.414f, 0.500f, 0u, 0.0630f, 0.1260f, 0.520f, 0.0050f, false, SfxClass::Normal, {{0.0f, 0.0f}, {0.0f, 0.0f}, {0.0f, 0.0f}, {0.0f, 0.0f}}, 0u, {{0.0f, 0.5f}, {0.0f, 0.5f}, {0.0f, 0.5f}, {0.0f, 0.5f}}, 0u},
/*  32 itemup   */ {SfxWave::Triangle, 200.5f, 0.0f, 0.2053f, 0.356f, 0.500f, 0u, 0.0010f, 0.1283f, 0.552f, 0.0050f, false, SfxClass::Normal, {{0.0f, 0.0f}, {0.0f, 0.0f}, {0.0f, 0.0f}, {0.0f, 0.0f}}, 0u, {{0.0f, 0.5f}, {0.0f, 0.5f}, {0.0f, 0.5f}, {0.0f, 0.5f}}, 0u},
/*  33 wpnup    */ {SfxWave::Noise, 12000.0f, 0.0f, 0.5329f, 0.564f, 0.500f, 0u, 0.0999f, 0.0333f, 0.326f, 0.0333f, true, SfxClass::Normal, {{0.0f, 0.0f}, {0.0f, 0.0f}, {0.0f, 0.0f}, {0.0f, 0.0f}}, 0u, {{0.0f, 0.5f}, {0.0f, 0.5f}, {0.0f, 0.5f}, {0.0f, 0.5f}}, 0u},
/*  34 oof      */ {SfxWave::Pulse, 143.8f, 0.0f, 0.3546f, 0.517f, 0.516f, 0u, 0.1108f, 0.1995f, 0.066f, 0.0222f, false, SfxClass::Normal, {{0.000f, 137.8f}, {0.118f, 173.4f}, {0.236f, 132.8f}, {0.355f, 91.1f}}, 4u, {{0.000f, 0.459f}, {0.118f, 0.527f}, {0.236f, 0.545f}, {0.355f, 0.408f}}, 4u},
/*  35 telept   */ {SfxWave::Noise, 6000.0f, 0.0f, 1.4044f, 0.692f, 0.500f, 0u, 0.4389f, 0.8778f, 0.292f, 0.0878f, false, SfxClass::Normal, {{0.0f, 0.0f}, {0.0f, 0.0f}, {0.0f, 0.0f}, {0.0f, 0.0f}}, 0u, {{0.0f, 0.5f}, {0.0f, 0.5f}, {0.0f, 0.5f}, {0.0f, 0.5f}}, 0u},
/*  36 posit1   */ {SfxWave::Noise, 3200.0f, 0.0f, 0.4838f, 0.884f, 0.500f, 0u, 0.1210f, 0.3326f, 0.270f, 0.0302f, false, SfxClass::Normal, {{0.0f, 0.0f}, {0.0f, 0.0f}, {0.0f, 0.0f}, {0.0f, 0.0f}}, 0u, {{0.0f, 0.5f}, {0.0f, 0.5f}, {0.0f, 0.5f}, {0.0f, 0.5f}}, 0u},
/*  37 posit2   */ {SfxWave::Noise, 3200.0f, 0.0f, 1.0229f, 0.950f, 0.500f, 0u, 0.3197f, 0.0639f, 0.774f, 0.0050f, false, SfxClass::Normal, {{0.0f, 0.0f}, {0.0f, 0.0f}, {0.0f, 0.0f}, {0.0f, 0.0f}}, 0u, {{0.0f, 0.5f}, {0.0f, 0.5f}, {0.0f, 0.5f}, {0.0f, 0.5f}}, 0u},
/*  38 posit3   */ {SfxWave::Noise, 2500.0f, 0.0f, 1.0063f, 0.698f, 0.500f, 0u, 0.0629f, 0.7547f, 0.040f, 0.1000f, false, SfxClass::Normal, {{0.0f, 0.0f}, {0.0f, 0.0f}, {0.0f, 0.0f}, {0.0f, 0.0f}}, 0u, {{0.0f, 0.5f}, {0.0f, 0.5f}, {0.0f, 0.5f}, {0.0f, 0.5f}}, 0u},
/*  39 bgsit1   */ {SfxWave::Noise, 4500.0f, 0.0f, 1.2359f, 0.758f, 0.500f, 0u, 0.3090f, 0.8497f, 0.143f, 0.0772f, false, SfxClass::Normal, {{0.0f, 0.0f}, {0.0f, 0.0f}, {0.0f, 0.0f}, {0.0f, 0.0f}}, 0u, {{0.0f, 0.5f}, {0.0f, 0.5f}, {0.0f, 0.5f}, {0.0f, 0.5f}}, 0u},
/*  40 bgsit2   */ {SfxWave::Noise, 6000.0f, 0.0f, 1.4580f, 0.718f, 0.500f, 0u, 0.4556f, 0.7290f, 0.050f, 0.1000f, false, SfxClass::Normal, {{0.0f, 0.0f}, {0.0f, 0.0f}, {0.0f, 0.0f}, {0.0f, 0.0f}}, 0u, {{0.0f, 0.5f}, {0.0f, 0.5f}, {0.0f, 0.5f}, {0.0f, 0.5f}}, 0u},
/*  41 sgtsit   */ {SfxWave::Noise, 2300.0f, 0.0f, 1.0126f, 0.723f, 0.500f, 0u, 0.5063f, 0.2531f, 0.073f, 0.1000f, false, SfxClass::Normal, {{0.0f, 0.0f}, {0.0f, 0.0f}, {0.0f, 0.0f}, {0.0f, 0.0f}}, 0u, {{0.0f, 0.5f}, {0.0f, 0.5f}, {0.0f, 0.5f}, {0.0f, 0.5f}}, 0u},
/*  42 cacsit   from bgsit1 */ {SfxWave::Noise, 4500.0f, 0.0f, 1.2359f, 0.758f, 0.500f, 0u, 0.3090f, 0.8497f, 0.143f, 0.0772f, false, SfxClass::Normal, {{0.0f, 0.0f}, {0.0f, 0.0f}, {0.0f, 0.0f}, {0.0f, 0.0f}}, 0u, {{0.0f, 0.5f}, {0.0f, 0.5f}, {0.0f, 0.5f}, {0.0f, 0.5f}}, 0u},
/*  43 brssit   */ {SfxWave::Noise, 3200.0f, 0.0f, 1.2483f, 0.905f, 0.500f, 0u, 0.0780f, 1.0923f, 0.526f, 0.0050f, false, SfxClass::Normal, {{0.0f, 0.0f}, {0.0f, 0.0f}, {0.0f, 0.0f}, {0.0f, 0.0f}}, 0u, {{0.0f, 0.5f}, {0.0f, 0.5f}, {0.0f, 0.5f}, {0.0f, 0.5f}}, 0u},
/*  44 cybsit   from brssit */ {SfxWave::Noise, 3200.0f, 0.0f, 1.2483f, 0.905f, 0.500f, 0u, 0.0780f, 1.0923f, 0.526f, 0.0050f, false, SfxClass::Normal, {{0.0f, 0.0f}, {0.0f, 0.0f}, {0.0f, 0.0f}, {0.0f, 0.0f}}, 0u, {{0.0f, 0.5f}, {0.0f, 0.5f}, {0.0f, 0.5f}, {0.0f, 0.5f}}, 0u},
/*  45 spisit   from posit1 */ {SfxWave::Noise, 3200.0f, 0.0f, 0.4838f, 0.884f, 0.500f, 0u, 0.1210f, 0.3326f, 0.270f, 0.0302f, false, SfxClass::Normal, {{0.0f, 0.0f}, {0.0f, 0.0f}, {0.0f, 0.0f}, {0.0f, 0.0f}}, 0u, {{0.0f, 0.5f}, {0.0f, 0.5f}, {0.0f, 0.5f}, {0.0f, 0.5f}}, 0u},
/*  46 bspsit   from bgsit2 */ {SfxWave::Noise, 6000.0f, 0.0f, 1.4580f, 0.718f, 0.500f, 0u, 0.4556f, 0.7290f, 0.050f, 0.1000f, false, SfxClass::Normal, {{0.0f, 0.0f}, {0.0f, 0.0f}, {0.0f, 0.0f}, {0.0f, 0.0f}}, 0u, {{0.0f, 0.5f}, {0.0f, 0.5f}, {0.0f, 0.5f}, {0.0f, 0.5f}}, 0u},
/*  47 kntsit   from bgsit1 */ {SfxWave::Noise, 4500.0f, 0.0f, 1.2359f, 0.758f, 0.500f, 0u, 0.3090f, 0.8497f, 0.143f, 0.0772f, false, SfxClass::Normal, {{0.0f, 0.0f}, {0.0f, 0.0f}, {0.0f, 0.0f}, {0.0f, 0.0f}}, 0u, {{0.0f, 0.5f}, {0.0f, 0.5f}, {0.0f, 0.5f}, {0.0f, 0.5f}}, 0u},
/*  48 vilsit   from bgsit2 */ {SfxWave::Noise, 6000.0f, 0.0f, 1.4580f, 0.718f, 0.500f, 0u, 0.4556f, 0.7290f, 0.050f, 0.1000f, false, SfxClass::Normal, {{0.0f, 0.0f}, {0.0f, 0.0f}, {0.0f, 0.0f}, {0.0f, 0.0f}}, 0u, {{0.0f, 0.5f}, {0.0f, 0.5f}, {0.0f, 0.5f}, {0.0f, 0.5f}}, 0u},
/*  49 mansit   from bgsit1 */ {SfxWave::Noise, 4500.0f, 0.0f, 1.2359f, 0.758f, 0.500f, 0u, 0.3090f, 0.8497f, 0.143f, 0.0772f, false, SfxClass::Normal, {{0.0f, 0.0f}, {0.0f, 0.0f}, {0.0f, 0.0f}, {0.0f, 0.0f}}, 0u, {{0.0f, 0.5f}, {0.0f, 0.5f}, {0.0f, 0.5f}, {0.0f, 0.5f}}, 0u},
/*  50 pesit    from bgsit2 */ {SfxWave::Noise, 6000.0f, 0.0f, 1.4580f, 0.718f, 0.500f, 0u, 0.4556f, 0.7290f, 0.050f, 0.1000f, false, SfxClass::Normal, {{0.0f, 0.0f}, {0.0f, 0.0f}, {0.0f, 0.0f}, {0.0f, 0.0f}}, 0u, {{0.0f, 0.5f}, {0.0f, 0.5f}, {0.0f, 0.5f}, {0.0f, 0.5f}}, 0u},
/*  51 sklatk   from claw */ {SfxWave::Noise, 12000.0f, 0.0f, 0.5809f, 0.813f, 0.500f, 0u, 0.1089f, 0.4357f, 0.524f, 0.0050f, true, SfxClass::Normal, {{0.0f, 0.0f}, {0.0f, 0.0f}, {0.0f, 0.0f}, {0.0f, 0.0f}}, 0u, {{0.0f, 0.5f}, {0.0f, 0.5f}, {0.0f, 0.5f}, {0.0f, 0.5f}}, 0u},
/*  52 sgtatk   */ {SfxWave::Noise, 3200.0f, 0.0f, 0.8481f, 0.683f, 0.500f, 0u, 0.1060f, 0.5301f, 0.305f, 0.0050f, false, SfxClass::Normal, {{0.0f, 0.0f}, {0.0f, 0.0f}, {0.0f, 0.0f}, {0.0f, 0.0f}}, 0u, {{0.0f, 0.5f}, {0.0f, 0.5f}, {0.0f, 0.5f}, {0.0f, 0.5f}}, 0u},
/*  53 skepch   from firsht */ {SfxWave::Noise, 6000.0f, 0.0f, 1.3370f, 0.639f, 0.500f, 0u, 0.4178f, 0.8356f, 0.213f, 0.0050f, false, SfxClass::Normal, {{0.0f, 0.0f}, {0.0f, 0.0f}, {0.0f, 0.0f}, {0.0f, 0.0f}}, 0u, {{0.0f, 0.5f}, {0.0f, 0.5f}, {0.0f, 0.5f}, {0.0f, 0.5f}}, 0u},
/*  54 vilatk   from firsht */ {SfxWave::Noise, 6000.0f, 0.0f, 1.3370f, 0.639f, 0.500f, 0u, 0.4178f, 0.8356f, 0.213f, 0.0050f, false, SfxClass::Normal, {{0.0f, 0.0f}, {0.0f, 0.0f}, {0.0f, 0.0f}, {0.0f, 0.0f}}, 0u, {{0.0f, 0.5f}, {0.0f, 0.5f}, {0.0f, 0.5f}, {0.0f, 0.5f}}, 0u},
/*  55 claw     */ {SfxWave::Noise, 12000.0f, 0.0f, 0.5809f, 0.813f, 0.500f, 0u, 0.1089f, 0.4357f, 0.524f, 0.0050f, true, SfxClass::Normal, {{0.0f, 0.0f}, {0.0f, 0.0f}, {0.0f, 0.0f}, {0.0f, 0.0f}}, 0u, {{0.0f, 0.5f}, {0.0f, 0.5f}, {0.0f, 0.5f}, {0.0f, 0.5f}}, 0u},
/*  56 skeswg   from claw */ {SfxWave::Noise, 12000.0f, 0.0f, 0.5809f, 0.813f, 0.500f, 0u, 0.1089f, 0.4357f, 0.524f, 0.0050f, true, SfxClass::Normal, {{0.0f, 0.0f}, {0.0f, 0.0f}, {0.0f, 0.0f}, {0.0f, 0.0f}}, 0u, {{0.0f, 0.5f}, {0.0f, 0.5f}, {0.0f, 0.5f}, {0.0f, 0.5f}}, 0u},
/*  57 pldeth   */ {SfxWave::Noise, 4500.0f, 0.0f, 0.9988f, 0.875f, 0.500f, 0u, 0.0624f, 0.8740f, 0.460f, 0.0050f, false, SfxClass::Reserved, {{0.0f, 0.0f}, {0.0f, 0.0f}, {0.0f, 0.0f}, {0.0f, 0.0f}}, 0u, {{0.0f, 0.5f}, {0.0f, 0.5f}, {0.0f, 0.5f}, {0.0f, 0.5f}}, 0u},
/*  58 pdiehi   */ {SfxWave::Noise, 3700.0f, 0.0f, 0.9828f, 0.950f, 0.500f, 0u, 0.0010f, 0.2457f, 0.498f, 0.0050f, false, SfxClass::Reserved, {{0.0f, 0.0f}, {0.0f, 0.0f}, {0.0f, 0.0f}, {0.0f, 0.0f}}, 0u, {{0.0f, 0.5f}, {0.0f, 0.5f}, {0.0f, 0.5f}, {0.0f, 0.5f}}, 0u},
/*  59 podth1   */ {SfxWave::Pulse, 159.7f, 0.0f, 1.1758f, 0.817f, 0.517f, 0u, 0.4409f, 0.6614f, 0.055f, 0.0735f, false, SfxClass::Normal, {{0.000f, 220.5f}, {0.392f, 178.2f}, {0.784f, 127.9f}, {1.176f, 137.8f}}, 4u, {{0.000f, 0.454f}, {0.392f, 0.536f}, {0.784f, 0.502f}, {1.176f, 0.469f}}, 4u},
/*  60 podth2   */ {SfxWave::Pulse, 176.3f, 0.0f, 0.8466f, 0.893f, 0.498f, 0u, 0.1587f, 0.5820f, 0.051f, 0.1000f, false, SfxClass::Normal, {{0.000f, 82.3f}, {0.282f, 215.1f}, {0.564f, 155.4f}, {0.847f, 186.9f}}, 4u, {{0.000f, 0.473f}, {0.282f, 0.507f}, {0.564f, 0.504f}, {0.847f, 0.545f}}, 4u},
/*  61 podth3   */ {SfxWave::Noise, 2800.0f, 0.0f, 0.9928f, 0.949f, 0.500f, 0u, 0.1862f, 0.7446f, 0.291f, 0.0621f, false, SfxClass::Normal, {{0.0f, 0.0f}, {0.0f, 0.0f}, {0.0f, 0.0f}, {0.0f, 0.0f}}, 0u, {{0.0f, 0.5f}, {0.0f, 0.5f}, {0.0f, 0.5f}, {0.0f, 0.5f}}, 0u},
/*  62 bgdth1   */ {SfxWave::Noise, 2500.0f, 0.0f, 0.6459f, 0.725f, 0.500f, 0u, 0.2422f, 0.3633f, 0.263f, 0.0050f, false, SfxClass::Normal, {{0.0f, 0.0f}, {0.0f, 0.0f}, {0.0f, 0.0f}, {0.0f, 0.0f}}, 0u, {{0.0f, 0.5f}, {0.0f, 0.5f}, {0.0f, 0.5f}, {0.0f, 0.5f}}, 0u},
/*  63 bgdth2   */ {SfxWave::Triangle, 159.3f, 0.0f, 0.8445f, 0.915f, 0.500f, 0u, 0.1583f, 0.6334f, 0.390f, 0.0050f, false, SfxClass::Normal, {{0.000f, 256.4f}, {0.282f, 141.2f}, {0.563f, 123.7f}, {0.845f, 98.4f}}, 4u, {{0.0f, 0.5f}, {0.0f, 0.5f}, {0.0f, 0.5f}, {0.0f, 0.5f}}, 0u},
/*  64 sgtdth   */ {SfxWave::Noise, 3200.0f, 0.0f, 1.1112f, 0.646f, 0.500f, 0u, 0.1389f, 0.3473f, 0.422f, 0.0050f, false, SfxClass::Normal, {{0.0f, 0.0f}, {0.0f, 0.0f}, {0.0f, 0.0f}, {0.0f, 0.0f}}, 0u, {{0.0f, 0.5f}, {0.0f, 0.5f}, {0.0f, 0.5f}, {0.0f, 0.5f}}, 0u},
/*  65 cacdth   from brsdth */ {SfxWave::Noise, 3200.0f, 0.0f, 1.0009f, 0.950f, 0.500f, 0u, 0.0010f, 0.8758f, 0.653f, 0.0050f, false, SfxClass::Normal, {{0.0f, 0.0f}, {0.0f, 0.0f}, {0.0f, 0.0f}, {0.0f, 0.0f}}, 0u, {{0.0f, 0.5f}, {0.0f, 0.5f}, {0.0f, 0.5f}, {0.0f, 0.5f}}, 0u},
/*  66 skldth   from podth1 */ {SfxWave::Pulse, 159.7f, 0.0f, 1.1758f, 0.817f, 0.517f, 0u, 0.4409f, 0.6614f, 0.055f, 0.0735f, false, SfxClass::Normal, {{0.000f, 220.5f}, {0.392f, 178.2f}, {0.784f, 127.9f}, {1.176f, 137.8f}}, 4u, {{0.000f, 0.454f}, {0.392f, 0.536f}, {0.784f, 0.502f}, {1.176f, 0.469f}}, 4u},
/*  67 brsdth   */ {SfxWave::Noise, 3200.0f, 0.0f, 1.0009f, 0.950f, 0.500f, 0u, 0.0010f, 0.8758f, 0.653f, 0.0050f, false, SfxClass::Normal, {{0.0f, 0.0f}, {0.0f, 0.0f}, {0.0f, 0.0f}, {0.0f, 0.0f}}, 0u, {{0.0f, 0.5f}, {0.0f, 0.5f}, {0.0f, 0.5f}, {0.0f, 0.5f}}, 0u},
/*  68 cybdth   from brsdth */ {SfxWave::Noise, 3200.0f, 0.0f, 1.0009f, 0.950f, 0.500f, 0u, 0.0010f, 0.8758f, 0.653f, 0.0050f, false, SfxClass::Normal, {{0.0f, 0.0f}, {0.0f, 0.0f}, {0.0f, 0.0f}, {0.0f, 0.0f}}, 0u, {{0.0f, 0.5f}, {0.0f, 0.5f}, {0.0f, 0.5f}, {0.0f, 0.5f}}, 0u},
/*  69 spidth   from brsdth */ {SfxWave::Noise, 3200.0f, 0.0f, 1.0009f, 0.950f, 0.500f, 0u, 0.0010f, 0.8758f, 0.653f, 0.0050f, false, SfxClass::Normal, {{0.0f, 0.0f}, {0.0f, 0.0f}, {0.0f, 0.0f}, {0.0f, 0.0f}}, 0u, {{0.0f, 0.5f}, {0.0f, 0.5f}, {0.0f, 0.5f}, {0.0f, 0.5f}}, 0u},
/*  70 bspdth   from brsdth */ {SfxWave::Noise, 3200.0f, 0.0f, 1.0009f, 0.950f, 0.500f, 0u, 0.0010f, 0.8758f, 0.653f, 0.0050f, false, SfxClass::Normal, {{0.0f, 0.0f}, {0.0f, 0.0f}, {0.0f, 0.0f}, {0.0f, 0.0f}}, 0u, {{0.0f, 0.5f}, {0.0f, 0.5f}, {0.0f, 0.5f}, {0.0f, 0.5f}}, 0u},
/*  71 vildth   from brsdth */ {SfxWave::Noise, 3200.0f, 0.0f, 1.0009f, 0.950f, 0.500f, 0u, 0.0010f, 0.8758f, 0.653f, 0.0050f, false, SfxClass::Normal, {{0.0f, 0.0f}, {0.0f, 0.0f}, {0.0f, 0.0f}, {0.0f, 0.0f}}, 0u, {{0.0f, 0.5f}, {0.0f, 0.5f}, {0.0f, 0.5f}, {0.0f, 0.5f}}, 0u},
/*  72 kntdth   from podth1 */ {SfxWave::Pulse, 159.7f, 0.0f, 1.1758f, 0.817f, 0.517f, 0u, 0.4409f, 0.6614f, 0.055f, 0.0735f, false, SfxClass::Normal, {{0.000f, 220.5f}, {0.392f, 178.2f}, {0.784f, 127.9f}, {1.176f, 137.8f}}, 4u, {{0.000f, 0.454f}, {0.392f, 0.536f}, {0.784f, 0.502f}, {1.176f, 0.469f}}, 4u},
/*  73 pedth    from podth1 */ {SfxWave::Pulse, 159.7f, 0.0f, 1.1758f, 0.817f, 0.517f, 0u, 0.4409f, 0.6614f, 0.055f, 0.0735f, false, SfxClass::Normal, {{0.000f, 220.5f}, {0.392f, 178.2f}, {0.784f, 127.9f}, {1.176f, 137.8f}}, 4u, {{0.000f, 0.454f}, {0.392f, 0.536f}, {0.784f, 0.502f}, {1.176f, 0.469f}}, 4u},
/*  74 skedth   from podth1 */ {SfxWave::Pulse, 159.7f, 0.0f, 1.1758f, 0.817f, 0.517f, 0u, 0.4409f, 0.6614f, 0.055f, 0.0735f, false, SfxClass::Normal, {{0.000f, 220.5f}, {0.392f, 178.2f}, {0.784f, 127.9f}, {1.176f, 137.8f}}, 4u, {{0.000f, 0.454f}, {0.392f, 0.536f}, {0.784f, 0.502f}, {1.176f, 0.469f}}, 4u},
/*  75 posact   */ {SfxWave::Noise, 4500.0f, 0.0f, 0.9772f, 0.416f, 0.500f, 0u, 0.3054f, 0.6108f, 0.177f, 0.0050f, false, SfxClass::Normal, {{0.0f, 0.0f}, {0.0f, 0.0f}, {0.0f, 0.0f}, {0.0f, 0.0f}}, 0u, {{0.0f, 0.5f}, {0.0f, 0.5f}, {0.0f, 0.5f}, {0.0f, 0.5f}}, 0u},
/*  76 bgact    */ {SfxWave::Noise, 2800.0f, 0.0f, 0.9092f, 0.424f, 0.500f, 0u, 0.2273f, 0.6251f, 0.214f, 0.0050f, false, SfxClass::Normal, {{0.0f, 0.0f}, {0.0f, 0.0f}, {0.0f, 0.0f}, {0.0f, 0.0f}}, 0u, {{0.0f, 0.5f}, {0.0f, 0.5f}, {0.0f, 0.5f}, {0.0f, 0.5f}}, 0u},
/*  77 dmact    */ {SfxWave::Noise, 1900.0f, 0.0f, 1.0747f, 0.772f, 0.500f, 0u, 0.0672f, 0.9404f, 0.214f, 0.0672f, false, SfxClass::Normal, {{0.0f, 0.0f}, {0.0f, 0.0f}, {0.0f, 0.0f}, {0.0f, 0.0f}}, 0u, {{0.0f, 0.5f}, {0.0f, 0.5f}, {0.0f, 0.5f}, {0.0f, 0.5f}}, 0u},
/*  78 bspact   from bgact */ {SfxWave::Noise, 2800.0f, 0.0f, 0.9092f, 0.424f, 0.500f, 0u, 0.2273f, 0.6251f, 0.214f, 0.0050f, false, SfxClass::Normal, {{0.0f, 0.0f}, {0.0f, 0.0f}, {0.0f, 0.0f}, {0.0f, 0.0f}}, 0u, {{0.0f, 0.5f}, {0.0f, 0.5f}, {0.0f, 0.5f}, {0.0f, 0.5f}}, 0u},
/*  79 bspwlk   from stnmov */ {SfxWave::Noise, 1900.0f, 0.0f, 0.2684f, 0.499f, 0.500f, 0u, 0.0336f, 0.0839f, 0.651f, 0.0050f, false, SfxClass::Normal, {{0.0f, 0.0f}, {0.0f, 0.0f}, {0.0f, 0.0f}, {0.0f, 0.0f}}, 0u, {{0.0f, 0.5f}, {0.0f, 0.5f}, {0.0f, 0.5f}, {0.0f, 0.5f}}, 0u},
/*  80 vilact   from bgact */ {SfxWave::Noise, 2800.0f, 0.0f, 0.9092f, 0.424f, 0.500f, 0u, 0.2273f, 0.6251f, 0.214f, 0.0050f, false, SfxClass::Normal, {{0.0f, 0.0f}, {0.0f, 0.0f}, {0.0f, 0.0f}, {0.0f, 0.0f}}, 0u, {{0.0f, 0.5f}, {0.0f, 0.5f}, {0.0f, 0.5f}, {0.0f, 0.5f}}, 0u},
/*  81 noway    */ {SfxWave::Pulse, 143.8f, 0.0f, 0.3546f, 0.517f, 0.516f, 0u, 0.1108f, 0.1995f, 0.066f, 0.0222f, false, SfxClass::Normal, {{0.000f, 137.8f}, {0.118f, 173.4f}, {0.236f, 132.8f}, {0.355f, 91.1f}}, 4u, {{0.000f, 0.459f}, {0.118f, 0.527f}, {0.236f, 0.545f}, {0.355f, 0.408f}}, 4u},
/*  82 barexp   */ {SfxWave::Noise, 3700.0f, 0.0f, 1.6863f, 0.711f, 0.500f, 0u, 0.0010f, 1.2647f, 0.124f, 0.0050f, false, SfxClass::High, {{0.0f, 0.0f}, {0.0f, 0.0f}, {0.0f, 0.0f}, {0.0f, 0.0f}}, 0u, {{0.0f, 0.5f}, {0.0f, 0.5f}, {0.0f, 0.5f}, {0.0f, 0.5f}}, 0u},
/*  83 punch    */ {SfxWave::Noise, 2300.0f, 0.0f, 0.2264f, 0.757f, 0.500f, 0u, 0.0283f, 0.0566f, 0.104f, 0.0707f, false, SfxClass::Reserved, {{0.0f, 0.0f}, {0.0f, 0.0f}, {0.0f, 0.0f}, {0.0f, 0.0f}}, 0u, {{0.0f, 0.5f}, {0.0f, 0.5f}, {0.0f, 0.5f}, {0.0f, 0.5f}}, 0u},
/*  84 hoof     from stnmov */ {SfxWave::Noise, 1900.0f, 0.0f, 0.2684f, 0.499f, 0.500f, 0u, 0.0336f, 0.0839f, 0.651f, 0.0050f, false, SfxClass::Normal, {{0.0f, 0.0f}, {0.0f, 0.0f}, {0.0f, 0.0f}, {0.0f, 0.0f}}, 0u, {{0.0f, 0.5f}, {0.0f, 0.5f}, {0.0f, 0.5f}, {0.0f, 0.5f}}, 0u},
/*  85 metal    from tink */ {SfxWave::Noise, 12000.0f, 0.0f, 0.0179f, 0.950f, 0.500f, 0u, 0.0010f, 0.0168f, 0.109f, 0.0050f, false, SfxClass::Normal, {{0.0f, 0.0f}, {0.0f, 0.0f}, {0.0f, 0.0f}, {0.0f, 0.0f}}, 0u, {{0.0f, 0.5f}, {0.0f, 0.5f}, {0.0f, 0.5f}, {0.0f, 0.5f}}, 0u},
/*  86 chgun    from pistol */ {SfxWave::Noise, 3200.0f, 0.0f, 0.5135f, 0.728f, 0.500f, 0u, 0.0010f, 0.3851f, 0.011f, 0.0963f, false, SfxClass::Reserved, {{0.0f, 0.0f}, {0.0f, 0.0f}, {0.0f, 0.0f}, {0.0f, 0.0f}}, 0u, {{0.0f, 0.5f}, {0.0f, 0.5f}, {0.0f, 0.5f}, {0.0f, 0.5f}}, 0u},
/*  87 tink     */ {SfxWave::Noise, 12000.0f, 0.0f, 0.0179f, 0.950f, 0.500f, 0u, 0.0010f, 0.0168f, 0.109f, 0.0050f, false, SfxClass::Normal, {{0.0f, 0.0f}, {0.0f, 0.0f}, {0.0f, 0.0f}, {0.0f, 0.0f}}, 0u, {{0.0f, 0.5f}, {0.0f, 0.5f}, {0.0f, 0.5f}, {0.0f, 0.5f}}, 0u},
/*  88 bdopn    */ {SfxWave::Noise, 3200.0f, 0.0f, 0.3792f, 0.609f, 0.500f, 0u, 0.0237f, 0.0237f, 0.343f, 0.0050f, false, SfxClass::High, {{0.0f, 0.0f}, {0.0f, 0.0f}, {0.0f, 0.0f}, {0.0f, 0.0f}}, 0u, {{0.0f, 0.5f}, {0.0f, 0.5f}, {0.0f, 0.5f}, {0.0f, 0.5f}}, 0u},
/*  89 bdcls    */ {SfxWave::Noise, 4500.0f, 0.0f, 0.3805f, 0.639f, 0.500f, 0u, 0.0010f, 0.1665f, 0.594f, 0.0050f, false, SfxClass::High, {{0.0f, 0.0f}, {0.0f, 0.0f}, {0.0f, 0.0f}, {0.0f, 0.0f}}, 0u, {{0.0f, 0.5f}, {0.0f, 0.5f}, {0.0f, 0.5f}, {0.0f, 0.5f}}, 0u},
/*  90 itmbk    */ {SfxWave::Noise, 4500.0f, 0.0f, 0.5068f, 0.950f, 0.500f, 0u, 0.2217f, 0.2534f, 0.240f, 0.0050f, false, SfxClass::Normal, {{0.0f, 0.0f}, {0.0f, 0.0f}, {0.0f, 0.0f}, {0.0f, 0.0f}}, 0u, {{0.0f, 0.5f}, {0.0f, 0.5f}, {0.0f, 0.5f}, {0.0f, 0.5f}}, 0u},
/*  91 flame    from firsht */ {SfxWave::Noise, 6000.0f, 0.0f, 1.3370f, 0.639f, 0.500f, 0u, 0.4178f, 0.8356f, 0.213f, 0.0050f, false, SfxClass::Normal, {{0.0f, 0.0f}, {0.0f, 0.0f}, {0.0f, 0.0f}, {0.0f, 0.0f}}, 0u, {{0.0f, 0.5f}, {0.0f, 0.5f}, {0.0f, 0.5f}, {0.0f, 0.5f}}, 0u},
/*  92 flamst   from firsht */ {SfxWave::Noise, 6000.0f, 0.0f, 1.3370f, 0.639f, 0.500f, 0u, 0.4178f, 0.8356f, 0.213f, 0.0050f, false, SfxClass::Normal, {{0.0f, 0.0f}, {0.0f, 0.0f}, {0.0f, 0.0f}, {0.0f, 0.0f}}, 0u, {{0.0f, 0.5f}, {0.0f, 0.5f}, {0.0f, 0.5f}, {0.0f, 0.5f}}, 0u},
/*  93 getpow   */ {SfxWave::Noise, 2500.0f, 0.0f, 0.7191f, 0.532f, 0.500f, 0u, 0.0449f, 0.6292f, 0.230f, 0.0449f, false, SfxClass::Normal, {{0.0f, 0.0f}, {0.0f, 0.0f}, {0.0f, 0.0f}, {0.0f, 0.0f}}, 0u, {{0.0f, 0.5f}, {0.0f, 0.5f}, {0.0f, 0.5f}, {0.0f, 0.5f}}, 0u},
/*  94 bospit   from dmpain */ {SfxWave::Noise, 2800.0f, 0.0f, 0.8627f, 0.907f, 0.500f, 0u, 0.0010f, 0.8088f, 0.406f, 0.0050f, false, SfxClass::Reserved, {{0.0f, 0.0f}, {0.0f, 0.0f}, {0.0f, 0.0f}, {0.0f, 0.0f}}, 0u, {{0.0f, 0.5f}, {0.0f, 0.5f}, {0.0f, 0.5f}, {0.0f, 0.5f}}, 0u},
/*  95 boscub   from bdopn */ {SfxWave::Noise, 3200.0f, 0.0f, 0.3792f, 0.609f, 0.500f, 0u, 0.0237f, 0.0237f, 0.343f, 0.0050f, false, SfxClass::Reserved, {{0.0f, 0.0f}, {0.0f, 0.0f}, {0.0f, 0.0f}, {0.0f, 0.0f}}, 0u, {{0.0f, 0.5f}, {0.0f, 0.5f}, {0.0f, 0.5f}, {0.0f, 0.5f}}, 0u},
/*  96 bossit   from brssit */ {SfxWave::Noise, 3200.0f, 0.0f, 1.2483f, 0.905f, 0.500f, 0u, 0.0780f, 1.0923f, 0.526f, 0.0050f, false, SfxClass::Reserved, {{0.0f, 0.0f}, {0.0f, 0.0f}, {0.0f, 0.0f}, {0.0f, 0.0f}}, 0u, {{0.0f, 0.5f}, {0.0f, 0.5f}, {0.0f, 0.5f}, {0.0f, 0.5f}}, 0u},
/*  97 bospn    from dmpain */ {SfxWave::Noise, 2800.0f, 0.0f, 0.8627f, 0.907f, 0.500f, 0u, 0.0010f, 0.8088f, 0.406f, 0.0050f, false, SfxClass::Reserved, {{0.0f, 0.0f}, {0.0f, 0.0f}, {0.0f, 0.0f}, {0.0f, 0.0f}}, 0u, {{0.0f, 0.5f}, {0.0f, 0.5f}, {0.0f, 0.5f}, {0.0f, 0.5f}}, 0u},
/*  98 bosdth   from brsdth */ {SfxWave::Noise, 3200.0f, 0.0f, 1.0009f, 0.950f, 0.500f, 0u, 0.0010f, 0.8758f, 0.653f, 0.0050f, false, SfxClass::Reserved, {{0.0f, 0.0f}, {0.0f, 0.0f}, {0.0f, 0.0f}, {0.0f, 0.0f}}, 0u, {{0.0f, 0.5f}, {0.0f, 0.5f}, {0.0f, 0.5f}, {0.0f, 0.5f}}, 0u},
/*  99 manatk   from firsht */ {SfxWave::Noise, 6000.0f, 0.0f, 1.3370f, 0.639f, 0.500f, 0u, 0.4178f, 0.8356f, 0.213f, 0.0050f, false, SfxClass::Normal, {{0.0f, 0.0f}, {0.0f, 0.0f}, {0.0f, 0.0f}, {0.0f, 0.0f}}, 0u, {{0.0f, 0.5f}, {0.0f, 0.5f}, {0.0f, 0.5f}, {0.0f, 0.5f}}, 0u},
/* 100 mandth   from brsdth */ {SfxWave::Noise, 3200.0f, 0.0f, 1.0009f, 0.950f, 0.500f, 0u, 0.0010f, 0.8758f, 0.653f, 0.0050f, false, SfxClass::Normal, {{0.0f, 0.0f}, {0.0f, 0.0f}, {0.0f, 0.0f}, {0.0f, 0.0f}}, 0u, {{0.0f, 0.5f}, {0.0f, 0.5f}, {0.0f, 0.5f}, {0.0f, 0.5f}}, 0u},
/* 101 sssit    from posit1 */ {SfxWave::Noise, 3200.0f, 0.0f, 0.4838f, 0.884f, 0.500f, 0u, 0.1210f, 0.3326f, 0.270f, 0.0302f, false, SfxClass::Normal, {{0.0f, 0.0f}, {0.0f, 0.0f}, {0.0f, 0.0f}, {0.0f, 0.0f}}, 0u, {{0.0f, 0.5f}, {0.0f, 0.5f}, {0.0f, 0.5f}, {0.0f, 0.5f}}, 0u},
/* 102 ssdth    from podth1 */ {SfxWave::Pulse, 159.7f, 0.0f, 1.1758f, 0.817f, 0.517f, 0u, 0.4409f, 0.6614f, 0.055f, 0.0735f, false, SfxClass::Normal, {{0.000f, 220.5f}, {0.392f, 178.2f}, {0.784f, 127.9f}, {1.176f, 137.8f}}, 4u, {{0.000f, 0.454f}, {0.392f, 0.536f}, {0.784f, 0.502f}, {1.176f, 0.469f}}, 4u},
/* 103 keenpn   from popain */ {SfxWave::Noise, 2800.0f, 0.0f, 0.7832f, 0.893f, 0.500f, 0u, 0.0010f, 0.2937f, 0.635f, 0.0050f, false, SfxClass::Normal, {{0.0f, 0.0f}, {0.0f, 0.0f}, {0.0f, 0.0f}, {0.0f, 0.0f}}, 0u, {{0.0f, 0.5f}, {0.0f, 0.5f}, {0.0f, 0.5f}, {0.0f, 0.5f}}, 0u},
/* 104 keendt   from podth1 */ {SfxWave::Pulse, 159.7f, 0.0f, 1.1758f, 0.817f, 0.517f, 0u, 0.4409f, 0.6614f, 0.055f, 0.0735f, false, SfxClass::Normal, {{0.000f, 220.5f}, {0.392f, 178.2f}, {0.784f, 127.9f}, {1.176f, 137.8f}}, 4u, {{0.000f, 0.454f}, {0.392f, 0.536f}, {0.784f, 0.502f}, {1.176f, 0.469f}}, 4u},
/* 105 skeact   from posact */ {SfxWave::Noise, 4500.0f, 0.0f, 0.9772f, 0.416f, 0.500f, 0u, 0.3054f, 0.6108f, 0.177f, 0.0050f, false, SfxClass::Normal, {{0.0f, 0.0f}, {0.0f, 0.0f}, {0.0f, 0.0f}, {0.0f, 0.0f}}, 0u, {{0.0f, 0.5f}, {0.0f, 0.5f}, {0.0f, 0.5f}, {0.0f, 0.5f}}, 0u},
/* 106 skesit   from posit1 */ {SfxWave::Noise, 3200.0f, 0.0f, 0.4838f, 0.884f, 0.500f, 0u, 0.1210f, 0.3326f, 0.270f, 0.0302f, false, SfxClass::Normal, {{0.0f, 0.0f}, {0.0f, 0.0f}, {0.0f, 0.0f}, {0.0f, 0.0f}}, 0u, {{0.0f, 0.5f}, {0.0f, 0.5f}, {0.0f, 0.5f}, {0.0f, 0.5f}}, 0u},
/* 107 skeatk   from sgtatk */ {SfxWave::Noise, 3200.0f, 0.0f, 0.8481f, 0.683f, 0.500f, 0u, 0.1060f, 0.5301f, 0.305f, 0.0050f, false, SfxClass::Normal, {{0.0f, 0.0f}, {0.0f, 0.0f}, {0.0f, 0.0f}, {0.0f, 0.0f}}, 0u, {{0.0f, 0.5f}, {0.0f, 0.5f}, {0.0f, 0.5f}, {0.0f, 0.5f}}, 0u},
/* 108 radio    from tink */ {SfxWave::Noise, 12000.0f, 0.0f, 0.0179f, 0.950f, 0.500f, 0u, 0.0010f, 0.0168f, 0.109f, 0.0050f, false, SfxClass::Normal, {{0.0f, 0.0f}, {0.0f, 0.0f}, {0.0f, 0.0f}, {0.0f, 0.0f}}, 0u, {{0.0f, 0.5f}, {0.0f, 0.5f}, {0.0f, 0.5f}, {0.0f, 0.5f}}, 0u},
